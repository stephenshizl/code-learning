## 调试素材/3588-30s项目器件/传感器/sprd参考/qmc6308/Kconfig
```kconfig
#
# Makefile for qmi8610 sensor driver.
#
config ALT_INPUT_QMC6308
	tristate "QMC6308 magnetic sensor device with I2C bus"
	depends on I2C
	default n
	help
	  Say Y here if you have a QMC6308 device on the board and use I2C
	  communication, else say N.

	  To compile this driver as a module, choose M here.
```

## 调试素材/3588-30s项目器件/传感器/sprd参考/qmi8610/Kconfig
```kconfig
#
# Makefile for qmi8610 sensor driver.
#
config ALT_INPUT_QMI8610
	tristate "QMI8610 gyro sensor device with I2C bus"
	depends on I2C
	default n
	help
	  Say Y here if you have a QMI8610 device on the board and use I2C
	  communication, else say N.

	  To compile this driver as a module, choose M here.
```

## 调试素材/3588-30s项目器件/传感器/sprd参考/sc7lc30/Kconfig
```kconfig
#
# Makefile for sc7lc30 sensor driver.
#
config ALT_INPUT_SC7LC30
	tristate "SC7LC30 light and proximity sensor device with I2C bus"
	depends on I2C
	default n
	help
	  Say Y here if you have a SC7LC30 device on the board and use I2C
	  communication, else say N.

	  To compile this driver as a module, choose M here.
```
